#include "ST7735.h"

extern "C" {
    #include "mik32_hal_spi.h"
    #include "mik32_hal_gpio.h"
    #include "mik32_hal_pcc.h"
    #include "mik32_hal.h"
}

static constexpr HAL_PinsTypeDef LCD_PIN_CS = GPIO_PIN_5;
static constexpr HAL_PinsTypeDef LCD_PIN_DC = GPIO_PIN_4;
static constexpr HAL_PinsTypeDef LCD_PIN_LED = GPIO_PIN_0;

static constexpr uint8_t SWRESET = 0x01;
static constexpr uint8_t SLPOUT  = 0x11;
static constexpr uint8_t DISPON  = 0x29;
static constexpr uint8_t CASET   = 0x2A;
static constexpr uint8_t PASET   = 0x2B;
static constexpr uint8_t RAMWR   = 0x2C;
static constexpr uint8_t MADCTL  = 0x36;
static constexpr uint8_t COLMOD  = 0x3A;

SPI_HandleTypeDef hspi1;
static uint8_t spi_rx_dummy[256];

extern "C" void HAL_SPI_MspInit(SPI_HandleTypeDef* hspi) {
    if (hspi->Instance != SPI_1) return;
    __HAL_PCC_SPI_1_CLK_ENABLE();
    GPIO_InitTypeDef s = {};
    s.Pin = static_cast<HAL_PinsTypeDef>(GPIO_PIN_1 | GPIO_PIN_2);
    s.Mode = HAL_GPIO_MODE_SERIAL;
    s.Pull = HAL_GPIO_PULL_NONE;
    HAL_GPIO_Init(GPIO_1, &s);
    s.Pin = GPIO_PIN_3;
    s.Mode = HAL_GPIO_MODE_SERIAL;
    s.Pull = HAL_GPIO_PULL_UP;
    HAL_GPIO_Init(GPIO_1, &s);
}

static void LCD_CS_Low()  { HAL_GPIO_WritePin(GPIO_1, LCD_PIN_CS, GPIO_PIN_LOW); }
static void LCD_CS_High() { HAL_GPIO_WritePin(GPIO_1, LCD_PIN_CS, GPIO_PIN_HIGH); }
static void LCD_DC_Cmd()  { HAL_GPIO_WritePin(GPIO_1, LCD_PIN_DC, GPIO_PIN_LOW); }
static void LCD_DC_Data() { HAL_GPIO_WritePin(GPIO_1, LCD_PIN_DC, GPIO_PIN_HIGH); }

static void LCD_SpiWrite(const uint8_t* data, uint32_t len) {
    while (len > 0) {
        uint32_t chunk = (len > sizeof(spi_rx_dummy)) ? sizeof(spi_rx_dummy) : len;
        HAL_SPI_Exchange(&hspi1, const_cast<uint8_t*>(data), spi_rx_dummy, chunk, SPI_TIMEOUT_DEFAULT);
        data += chunk;
        len -= chunk;
    }
}

static void LCD_WriteCmd(uint8_t cmd) {
    LCD_CS_Low();
    LCD_DC_Cmd();
    LCD_SpiWrite(&cmd, 1);
    LCD_DC_Data();
}

static void LCD_WriteData(const uint8_t* data, uint32_t len) {
    LCD_SpiWrite(data, len);
    LCD_CS_High();
}

static void LCD_WriteCmdData(uint8_t cmd, const uint8_t* data, uint32_t len) {
    LCD_WriteCmd(cmd);
    LCD_WriteData(data, len);
}

void LCD_Init(void) {
    __HAL_PCC_GPIO_1_CLK_ENABLE();
    GPIO_InitTypeDef s = {};
    s.Pin = static_cast<HAL_PinsTypeDef>(GPIO_PIN_4 | GPIO_PIN_5 | GPIO_PIN_0);
    s.Mode = HAL_GPIO_MODE_GPIO_OUTPUT;
    s.Pull = HAL_GPIO_PULL_NONE;
    HAL_GPIO_Init(GPIO_1, &s);
    HAL_GPIO_WritePin(GPIO_1, LCD_PIN_CS, GPIO_PIN_HIGH);
    hspi1.Instance = SPI_1;
    hspi1.Init.SPI_Mode = HAL_SPI_MODE_MASTER;
    hspi1.Init.CLKPhase = SPI_PHASE_OFF;
    hspi1.Init.CLKPolarity = SPI_POLARITY_LOW;
    hspi1.Init.ThresholdTX = 4;
    hspi1.Init.BaudRateDiv = SPI_BAUDRATE_DIV4;
    hspi1.Init.Decoder = SPI_DECODER_NONE;
    hspi1.Init.ManualCS = SPI_MANUALCS_ON;
    hspi1.Init.ChipSelect = SPI_CS_0;
    HAL_SPI_Init(&hspi1);
    __HAL_SPI_ENABLE(&hspi1);
    LCD_WriteCmd(SWRESET); HAL_DelayMs(150);
    LCD_WriteCmd(SLPOUT);  HAL_DelayMs(150);
    static const uint8_t cfg_CF[] = {0x00, 0xC1, 0x30};
    LCD_WriteCmdData(0xCF, cfg_CF, 3);
    static const uint8_t cfg_ED[] = {0x64, 0x03, 0x12, 0x81};
    LCD_WriteCmdData(0xED, cfg_ED, 4);
    static const uint8_t cfg_E8[] = {0x85, 0x00, 0x78};
    LCD_WriteCmdData(0xE8, cfg_E8, 3);
    static const uint8_t cfg_CB[] = {0x39, 0x2C, 0x00, 0x34, 0x02};
    LCD_WriteCmdData(0xCB, cfg_CB, 5);
    static const uint8_t cfg_F7 = 0x20;
    LCD_WriteCmdData(0xF7, &cfg_F7, 1);
    static const uint8_t cfg_EA[] = {0x00, 0x00};
    LCD_WriteCmdData(0xEA, cfg_EA, 2);
    static const uint8_t cfg_C0 = 0x23;
    LCD_WriteCmdData(0xC0, &cfg_C0, 1);
    static const uint8_t cfg_C1 = 0x10;
    LCD_WriteCmdData(0xC1, &cfg_C1, 1);
    static const uint8_t cfg_C5[] = {0x3E, 0x28};
    LCD_WriteCmdData(0xC5, cfg_C5, 2);
    static const uint8_t cfg_C7 = 0x86;
    LCD_WriteCmdData(0xC7, &cfg_C7, 1);
    static const uint8_t madctl = 0x68;
    LCD_WriteCmdData(MADCTL, &madctl, 1);
    static const uint8_t cfg_COL = 0x55;
    LCD_WriteCmdData(COLMOD, &cfg_COL, 1);
    static const uint8_t cfg_B1[] = {0x00, 0x18};
    LCD_WriteCmdData(0xB1, cfg_B1, 2);
    static const uint8_t cfg_B6[] = {0x08, 0x82, 0x27};
    LCD_WriteCmdData(0xB6, cfg_B6, 3);
    static const uint8_t cfg_F2 = 0x00;
    LCD_WriteCmdData(0xF2, &cfg_F2, 1);
    static const uint8_t cfg_GAM = 0x01;
    LCD_WriteCmdData(0x26, &cfg_GAM, 1);
    static const uint8_t cfg_E0[] = {0x0F, 0x31, 0x2B, 0x0C, 0x0E, 0x08, 0x4E, 0xF1, 0x37, 0x07, 0x10, 0x03, 0x0E, 0x09, 0x00};
    LCD_WriteCmdData(0xE0, cfg_E0, 15);
    static const uint8_t cfg_E1[] = {0x00, 0x0E, 0x14, 0x03, 0x11, 0x07, 0x31, 0xC1, 0x48, 0x08, 0x0F, 0x0C, 0x31, 0x36, 0x0F};
    LCD_WriteCmdData(0xE1, cfg_E1, 15);
    LCD_WriteCmd(DISPON); HAL_DelayMs(100);
    HAL_GPIO_WritePin(GPIO_1, LCD_PIN_LED, GPIO_PIN_HIGH);
    LCD_FillScreen(POLY_BG);
}

static void LCD_SetWindow(int x0, int y0, int x1, int y1) {
    uint8_t buf[4];
    buf[0] = static_cast<uint8_t>(x0 >> 8); buf[1] = static_cast<uint8_t>(x0 & 0xFF);
    buf[2] = static_cast<uint8_t>(x1 >> 8); buf[3] = static_cast<uint8_t>(x1 & 0xFF);
    LCD_WriteCmdData(CASET, buf, 4);
    buf[0] = static_cast<uint8_t>(y0 >> 8); buf[1] = static_cast<uint8_t>(y0 & 0xFF);
    buf[2] = static_cast<uint8_t>(y1 >> 8); buf[3] = static_cast<uint8_t>(y1 & 0xFF);
    LCD_WriteCmdData(PASET, buf, 4);
    LCD_WriteCmd(RAMWR);
}

static bool LCD_Clip(int* x, int* y, int* w, int* h) {
    if (*w <= 0 || *h <= 0) return false;
    if (*x < 0) { *w += *x; *x = 0; }
    if (*y < 0) { *h += *y; *y = 0; }
    if (*x + *w > LCD_W) *w = LCD_W - *x;
    if (*y + *h > LCD_H) *h = LCD_H - *y;
    return (*w > 0 && *h > 0);
}

void LCD_FillRect(int x, int y, int w, int h, uint16_t color) {
    if (!LCD_Clip(&x, &y, &w, &h)) return;
    LCD_SetWindow(x, y, x + w - 1, y + h - 1);
    static uint8_t txbuf[256];
    for (int i = 0; i < 128; ++i) {
        txbuf[2 * i] = static_cast<uint8_t>(color >> 8);
        txbuf[2 * i + 1] = static_cast<uint8_t>(color & 0xFF);
    }
    LCD_CS_Low();
    LCD_DC_Data();
    uint32_t left = static_cast<uint32_t>(w) * static_cast<uint32_t>(h) * 2;
    while (left > 0) {
        uint32_t chunk = (left > sizeof(txbuf)) ? sizeof(txbuf) : left;
        LCD_SpiWrite(txbuf, chunk);
        left -= chunk;
    }
    LCD_CS_High();
}

void LCD_FillScreen(uint16_t color) { LCD_FillRect(0, 0, LCD_W, LCD_H, color); }

void LCD_DrawPixel(int x, int y, uint16_t color) {
    if (x < 0 || x >= LCD_W || y < 0 || y >= LCD_H) return;
    LCD_SetWindow(x, y, x, y);
    uint8_t px[2] = {static_cast<uint8_t>(color >> 8), static_cast<uint8_t>(color & 0xFF)};
    LCD_CS_Low();
    LCD_DC_Data();
    LCD_SpiWrite(px, 2);
    LCD_CS_High();
}

void LCD_DrawCircle(int cx, int cy, int r, uint16_t color) {
    int x = r, y = 0, err = 0;
    while (x >= y) {
        LCD_DrawPixel(cx + x, cy + y, color);
        LCD_DrawPixel(cx + y, cy + x, color);
        LCD_DrawPixel(cx - y, cy + x, color);
        LCD_DrawPixel(cx - x, cy + y, color);
        LCD_DrawPixel(cx - x, cy - y, color);
        LCD_DrawPixel(cx - y, cy - x, color);
        LCD_DrawPixel(cx + y, cy - x, color);
        LCD_DrawPixel(cx + x, cy - y, color);
        ++y;
        err += 1 + 2 * y;
        if (2 * (err - x) + 1 > 0) { --x; err += 1 - 2 * x; }
    }
}

static const uint8_t kFont5x7[][5] = {
    {0x00,0x00,0x00,0x00,0x00},{0x00,0x00,0x5F,0x00,0x00},{0x00,0x07,0x00,0x07,0x00},{0x14,0x7F,0x14,0x7F,0x14},{0x24,0x2A,0x7F,0x2A,0x12},{0x23,0x13,0x08,0x64,0x62},{0x36,0x49,0x55,0x22,0x50},{0x00,0x05,0x03,0x00,0x00},{0x00,0x1C,0x22,0x41,0x00},{0x00,0x41,0x22,0x1C,0x00},{0x14,0x08,0x3E,0x08,0x14},{0x08,0x08,0x3E,0x08,0x08},{0x00,0x50,0x30,0x00,0x00},{0x08,0x08,0x08,0x08,0x08},{0x00,0x60,0x60,0x00,0x00},{0x20,0x10,0x08,0x04,0x02},{0x3E,0x51,0x49,0x45,0x3E},{0x00,0x42,0x7F,0x40,0x00},{0x42,0x61,0x51,0x49,0x46},{0x21,0x41,0x45,0x4B,0x31},{0x18,0x14,0x12,0x7F,0x10},{0x27,0x45,0x45,0x45,0x39},{0x3C,0x4A,0x49,0x49,0x30},{0x01,0x71,0x09,0x05,0x03},{0x36,0x49,0x49,0x49,0x36},{0x06,0x49,0x49,0x29,0x1E},{0x00,0x36,0x36,0x00,0x00},{0x00,0x56,0x36,0x00,0x00},{0x08,0x14,0x22,0x41,0x00},{0x14,0x14,0x14,0x14,0x14},{0x00,0x41,0x22,0x14,0x08},{0x02,0x01,0x51,0x09,0x06},{0x32,0x49,0x79,0x41,0x3E},{0x7E,0x11,0x11,0x11,0x7E},{0x7F,0x49,0x49,0x49,0x36},{0x3E,0x41,0x41,0x41,0x22},{0x7F,0x41,0x41,0x22,0x1C},{0x7F,0x49,0x49,0x49,0x41},{0x7F,0x48,0x48,0x48,0x40},{0x3E,0x41,0x49,0x49,0x7A},{0x7F,0x08,0x08,0x08,0x7F},{0x00,0x41,0x7F,0x41,0x00},{0x20,0x40,0x41,0x3F,0x01},{0x7F,0x08,0x14,0x22,0x41},{0x7F,0x40,0x40,0x40,0x40},{0x7F,0x02,0x0C,0x02,0x7F},{0x7F,0x04,0x08,0x10,0x7F},{0x3E,0x41,0x41,0x41,0x3E},{0x7F,0x09,0x09,0x09,0x06},{0x3E,0x41,0x51,0x21,0x5E},{0x7F,0x09,0x19,0x29,0x46},{0x46,0x49,0x49,0x49,0x31},{0x01,0x01,0x7F,0x01,0x01},{0x7F,0x40,0x40,0x40,0x7F},{0x0F,0x3C,0x60,0x3C,0x0F},{0x7F,0x40,0x38,0x40,0x7F},{0x63,0x14,0x08,0x14,0x63},{0x07,0x08,0x70,0x08,0x07},{0x61,0x51,0x49,0x45,0x43},{0x00,0x7F,0x41,0x41,0x00},{0x02,0x04,0x08,0x10,0x20},{0x00,0x41,0x41,0x7F,0x00},{0x04,0x02,0x01,0x02,0x04},{0x40,0x40,0x40,0x40,0x40},
};

static const uint8_t kFontLower[][5] = {
    {0x20,0x54,0x54,0x54,0x78},{0x7F,0x48,0x44,0x44,0x38},{0x38,0x44,0x44,0x44,0x20},{0x38,0x44,0x44,0x48,0x7F},{0x38,0x54,0x54,0x54,0x18},{0x08,0x7E,0x09,0x01,0x02},{0x0C,0x52,0x52,0x52,0x3E},{0x7F,0x08,0x04,0x04,0x78},{0x00,0x44,0x7D,0x40,0x00},{0x20,0x40,0x44,0x3D,0x00},{0x7F,0x10,0x28,0x44,0x00},{0x00,0x41,0x7F,0x40,0x00},{0x7C,0x04,0x18,0x04,0x78},{0x7C,0x08,0x04,0x04,0x78},{0x38,0x44,0x44,0x44,0x38},{0x7C,0x14,0x14,0x14,0x08},{0x08,0x14,0x14,0x18,0x7C},{0x7C,0x08,0x04,0x04,0x08},{0x48,0x54,0x54,0x54,0x20},{0x04,0x3F,0x44,0x40,0x20},{0x7C,0x40,0x40,0x40,0x7C},{0x1C,0x20,0x40,0x20,0x1C},{0x3C,0x40,0x30,0x40,0x3C},{0x44,0x28,0x10,0x28,0x44},{0x0C,0x50,0x50,0x50,0x3C},{0x44,0x64,0x54,0x4C,0x44},
};

static const uint8_t kFontCyr[][5] = {
    {0x7E,0x11,0x11,0x11,0x7E},{0x7F,0x49,0x49,0x49,0x36},{0x7F,0x49,0x49,0x49,0x36},{0x7F,0x01,0x01,0x01,0x01},{0x7F,0x41,0x41,0x41,0x7F},{0x7F,0x49,0x49,0x49,0x41},{0x63,0x14,0x7F,0x14,0x63},{0x21,0x41,0x45,0x4B,0x31},{0x7F,0x10,0x08,0x04,0x7F},{0x7F,0x10,0x0A,0x04,0x7F},{0x7F,0x08,0x14,0x22,0x41},{0x7F,0x02,0x04,0x08,0x70},{0x7F,0x02,0x0C,0x02,0x7F},{0x7F,0x08,0x08,0x08,0x7F},{0x3E,0x51,0x49,0x45,0x3E},{0x7F,0x01,0x01,0x01,0x7F},{0x7F,0x09,0x09,0x09,0x06},{0x3E,0x41,0x41,0x41,0x22},{0x01,0x01,0x7F,0x01,0x01},{0x07,0x08,0x70,0x08,0x07},{0x1C,0x22,0x7F,0x22,0x1C},{0x63,0x14,0x08,0x14,0x63},{0x7F,0x40,0x40,0x40,0x7E},{0x0F,0x08,0x08,0x08,0x7F},{0x7F,0x40,0x7F,0x40,0x7F},{0x7F,0x40,0x47,0x60,0x3F},{0x7F,0x09,0x09,0x09,0x06},{0x7F,0x48,0x48,0x48,0x7F},{0x7F,0x48,0x48,0x48,0x30},{0x3E,0x41,0x49,0x41,0x3E},{0x7F,0x08,0x3E,0x41,0x3E},{0x06,0x09,0x09,0x09,0x7F},
};

void LCD_Text(int x, int y, const char* str, uint16_t fg, uint16_t bg, int size) {
    while (*str) {
        const uint8_t* glyph = kFont5x7[0];
        unsigned char c = static_cast<unsigned char>(*str++);
        if (c < 0x80) {
            if (c >= 0x20 && c <= 0x5F) glyph = kFont5x7[c - 0x20];
            else if (c >= 'a' && c <= 'z') glyph = kFontLower[c - 'a'];
        } else if (c == 0xD0 && *str) {
            unsigned char d = static_cast<unsigned char>(*str++);
            if (d >= 0x90 && d <= 0xAF) glyph = kFontCyr[d - 0x90];
            else if (d >= 0xB0 && d <= 0xBF) glyph = kFontCyr[d - 0xB0];
            else if (d == 0x81) glyph = kFontCyr[5];
        } else if (c == 0xD1 && *str) {
            unsigned char d = static_cast<unsigned char>(*str++);
            if (d >= 0x80 && d <= 0x8F) glyph = kFontCyr[16 + (d - 0x80)];
            else if (d == 0x91) glyph = kFontCyr[5];
        } else {
            continue;
        }
        LCD_FillRect(x, y, 6 * size, 8 * size, bg);
        for (int col = 0; col < 5; ++col) {
            uint8_t bits = glyph[col];
            for (int row = 0; row < 7; ++row) {
                if (bits & (1 << row)) {
                    LCD_FillRect(x + col * size, y + row * size, size, size, fg);
                }
            }
        }
        x += 6 * size;
    }
}

int LCD_TextWidth(const char* str, int size) {
    int n = 0;
    for (const char* p = str; *p;) {
        unsigned char c = static_cast<unsigned char>(*p++);
        if (c < 0x80) { ++n; }
        else if ((c == 0xD0 || c == 0xD1) && *p) { ++p; ++n; }
    }
    return (n > 0) ? (n * 6 * size - size) : 0;
}

void LCD_TextCentered(int y, const char* str, uint16_t fg, uint16_t bg, int size) {
    int w = LCD_TextWidth(str, size);
    LCD_Text((LCD_W - w) / 2, y, str, fg, bg, size);
}

static const uint8_t kSegMap[10] = {0x3F,0x06,0x5B,0x4F,0x66,0x6D,0x7D,0x07,0x7F,0x6F};

void LCD_SevenSeg(int x, int y, int digit, int L, int T, uint16_t fg, uint16_t bg) {
    if (digit < 0 || digit > 9) digit = 0;
    int w = L + 2 * T;
    int h = 2 * L + 3 * T;
    LCD_FillRect(x, y, w, h, bg);
    uint8_t segs = kSegMap[digit];
    if (segs & 0x01) LCD_FillRect(x + T, y, L, T, fg);
    if (segs & 0x02) LCD_FillRect(x + T + L, y + T, T, L, fg);
    if (segs & 0x04) LCD_FillRect(x + T + L, y + 2 * T + L, T, L, fg);
    if (segs & 0x08) LCD_FillRect(x + T, y + 2 * L + 2 * T, L, T, fg);
    if (segs & 0x10) LCD_FillRect(x, y + 2 * T + L, T, L, fg);
    if (segs & 0x20) LCD_FillRect(x, y + T, T, L, fg);
    if (segs & 0x40) LCD_FillRect(x + T, y + L + T, L, T, fg);
}

void LCD_PushRow(int x, int y, int w, const uint16_t* px) {
    if (w <= 0 || x >= LCD_W || y < 0 || y >= LCD_H) return;
    if (x < 0) { px -= x; w += x; x = 0; }
    if (x + w > LCD_W) w = LCD_W - x;
    if (w <= 0) return;
    LCD_SetWindow(x, y, x + w - 1, y);
    LCD_CS_Low();
    LCD_DC_Data();
    static uint8_t txbuf[256];
    int left = w;
    while (left > 0) {
        int chunk = (left > 128) ? 128 : left;
        for (int i = 0; i < chunk; ++i) {
            txbuf[2 * i] = static_cast<uint8_t>(px[i] >> 8);
            txbuf[2 * i + 1] = static_cast<uint8_t>(px[i] & 0xFF);
        }
        LCD_SpiWrite(txbuf, static_cast<uint32_t>(chunk) * 2);
        px += chunk;
        left -= chunk;
    }
    LCD_CS_High();
}
